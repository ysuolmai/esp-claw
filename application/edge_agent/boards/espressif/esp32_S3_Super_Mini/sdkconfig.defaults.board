## application/edge_agent/boards/espressif/esp32_S3_Super_Mini/sdkconfig.defaults.board
```kconfig
# ESP32-S3 SuperMini / ESP32-S3FH4R2
# Reference: ysuolmai/xiaozhi-esp32s3-supermini.
# 4 MB in-package Quad SPI flash + 2 MB in-package Quad SPI PSRAM.
CONFIG_ESP_DEFAULT_CPU_FREQ_MHZ_240=y

CONFIG_ESPTOOLPY_FLASHMODE_QIO=y
CONFIG_ESPTOOLPY_FLASHMODE="qio"
CONFIG_ESPTOOLPY_FLASHFREQ_80M=y
CONFIG_ESPTOOLPY_FLASHSIZE_4MB=y
CONFIG_ESPTOOLPY_FLASHSIZE="4MB"

CONFIG_PARTITION_TABLE_CUSTOM=y
CONFIG_PARTITION_TABLE_CUSTOM_FILENAME="partitions_4MB.csv"

CONFIG_SPIRAM=y
CONFIG_SPIRAM_MODE_QUAD=y
CONFIG_SPIRAM_TYPE_AUTO=y
CONFIG_SPIRAM_SPEED_80M=y
CONFIG_SPIRAM_USE_MALLOC=y
CONFIG_SPIRAM_MALLOC_ALWAYSINTERNAL=16384
CONFIG_SPIRAM_MALLOC_RESERVE_INTERNAL=32768

# 2 MB Quad PSRAM is too small and the wrong mode for S3 XIP-from-PSRAM.
CONFIG_SPIRAM_XIP_FROM_PSRAM=n
CONFIG_SPIRAM_FETCH_INSTRUCTIONS=n
CONFIG_SPIRAM_RODATA=n
CONFIG_FREERTOS_TASK_CREATE_ALLOW_EXT_MEM=n
CONFIG_MDNS_TASK_CREATE_FROM_INTERNAL=y
CONFIG_MDNS_TASK_CREATE_FROM_SPIRAM=n

CONFIG_ESP_CONSOLE_USB_SERIAL_JTAG=y
CONFIG_ESP_CONSOLE_SECONDARY_NONE=y
CONFIG_ESP_CONSOLE_USB_SERIAL_JTAG_ENABLED=y

CONFIG_APP_WIFI_FORCE_PROVISION_GPIO=0
CONFIG_APP_WIFI_FORCE_PROVISION_HOLD_MS=5000
CONFIG_APP_STATUS_LED_WS2812_GPIO=48
CONFIG_APP_STATUS_LED_AP_BLINK_MS=800
CONFIG_APP_VOICE_PTT_GPIO=0
CONFIG_APP_VOICE_PTT_ACTIVE_LEVEL=0
CONFIG_APP_VOICE_PTT_MAX_RECORD_MS=60000
CONFIG_APP_VOICE_PTT_MIN_RECORD_MS=300
CONFIG_APP_VOICE_PTT_PLAYBACK_TIMEOUT_MS=20000

CONFIG_PM_ENABLE=y
CONFIG_FREERTOS_USE_TICKLESS_IDLE=y
CONFIG_ESP_MAIN_TASK_STACK_SIZE=7168
CONFIG_FREERTOS_IDLE_TASK_STACKSIZE=1536

# Keep networking lean for the 512 KB internal SRAM / 2 MB PSRAM target.
CONFIG_ESP_WIFI_ENABLE_WPA3_SAE=n
CONFIG_ESP_WIFI_ESPNOW_MAX_ENCRYPT_NUM=0
CONFIG_ESP_WIFI_ENTERPRISE_SUPPORT=n
CONFIG_LWIP_MAX_SOCKETS=10
CONFIG_LWIP_IPV6=n
CONFIG_LWIP_TCPIP_TASK_STACK_SIZE=2048
CONFIG_MBEDTLS_DYNAMIC_FREE_CONFIG_DATA=y
CONFIG_NEWLIB_NANO_FORMAT=y
CONFIG_COMPILER_OPTIMIZATION_SIZE=y

# 4 MB flash profile: keep Web/local configuration, Lua, files, skills, and
# system tools; omit large optional integrations and media/display stacks.
CONFIG_APP_CLAW_ENABLE_EMOTE=n
CONFIG_APP_CLAW_MEMORY_MODE_FULL=n
CONFIG_APP_CLAW_MEMORY_MODE_LIGHTWEIGHT=y
CONFIG_BT_ENABLED=n

CONFIG_APP_CLAW_CAP_AGENT_MGR=n
CONFIG_APP_CLAW_CAP_IM_QQ=n
CONFIG_APP_CLAW_CAP_IM_FEISHU=n
CONFIG_APP_CLAW_CAP_IM_TG=y
CONFIG_APP_CLAW_CAP_IM_WECHAT=n
CONFIG_APP_CLAW_CAP_MCP_CLIENT=y
CONFIG_APP_CLAW_CAP_MCP_SERVER=y
CONFIG_APP_CLAW_CAP_SCHEDULER=y
CONFIG_APP_CLAW_CAP_LLM_INSPECT=y
CONFIG_APP_CLAW_CAP_WEB_SEARCH=y

CONFIG_APP_CLAW_LUA_DRIVER_ADC=y
CONFIG_APP_CLAW_LUA_DRIVER_GPIO=y
CONFIG_APP_CLAW_LUA_DRIVER_I2C=y
CONFIG_APP_CLAW_LUA_DRIVER_MCPWM=y
CONFIG_APP_CLAW_LUA_DRIVER_PCNT=y
CONFIG_APP_CLAW_LUA_DRIVER_TOUCH=y
CONFIG_APP_CLAW_LUA_DRIVER_UART=y

CONFIG_APP_CLAW_LUA_MODULE_AUDIO=y
CONFIG_APP_CLAW_LUA_MODULE_BLE=n
CONFIG_APP_CLAW_LUA_MODULE_BLE_HID=n
CONFIG_APP_CLAW_LUA_MODULE_BUTTON=y
CONFIG_APP_CLAW_LUA_MODULE_CAMERA=n
CONFIG_APP_CLAW_LUA_MODULE_DISPLAY=n
CONFIG_APP_CLAW_LUA_MODULE_ENVIRONMENTAL_SENSOR=y
CONFIG_APP_CLAW_LUA_MODULE_FUEL_GAUGE=y
CONFIG_APP_CLAW_LUA_MODULE_HTTP_SERVER=n
CONFIG_APP_CLAW_LUA_MODULE_IMAGE=n
CONFIG_APP_CLAW_LUA_MODULE_IMU=y
CONFIG_APP_CLAW_LUA_MODULE_IR=y
CONFIG_APP_CLAW_LUA_MODULE_KNOB=y
CONFIG_APP_CLAW_LUA_MODULE_LCD=n
CONFIG_APP_CLAW_LUA_MODULE_LCD_TOUCH=n
CONFIG_APP_CLAW_LUA_MODULE_LED_STRIP=y
CONFIG_APP_CLAW_LUA_MODULE_LVGL=n
CONFIG_APP_CLAW_LUA_MODULE_MAGNETOMETER=y
CONFIG_APP_CLAW_LUA_MODULE_SCI=n
CONFIG_APP_CLAW_LUA_MODULE_VISION=n

CONFIG_ESP_BOARD_PERIPH_I2S_SUPPORT=y
CONFIG_ESP_BOARD_DEV_AUDIO_CODEC_SUPPORT=y
CONFIG_CODEC_DUMMY_SUPPORT=y
CONFIG_CODEC_DATA_ADC_SUPPORT=y

CONFIG_AUDIO_DECODER_AAC_SUPPORT=n
CONFIG_AUDIO_DECODER_MP3_SUPPORT=n
CONFIG_AUDIO_DECODER_FLAC_SUPPORT=n
CONFIG_AUDIO_DECODER_OPUS_SUPPORT=y
CONFIG_AUDIO_ENCODER_OPUS_SUPPORT=y
```

## application/edge_agent/main/Kconfig.projbuild
```kconfig
menu "App Config"

menu "Default Wi-Fi Settings"

    config APP_WIFI_SSID
        string "Default Wi-Fi SSID"
        default ""
        help
            Default Wi-Fi SSID used to populate app settings.

    config APP_WIFI_PASSWORD
        string "Default Wi-Fi password"
        default ""
        help
            Default Wi-Fi password used to populate app settings.

    config APP_WIFI_AP_SSID_PREFIX
        string "Provisioning AP SSID prefix"
        default "esp-claw"
        help
            Prefix used to build the unique provisioning AP SSID. The full
            SSID is "<prefix>-<MAC[3..5]>" (e.g. esp-claw-84AEE5).

    config APP_WIFI_AP_CHANNEL
        int "Provisioning AP channel"
        range 1 13
        default 1
        help
            Channel used by the provisioning SoftAP.

    config APP_WIFI_AP_MAX_CONN
        int "Provisioning AP max connections"
        range 1 10
        default 4
        help
            Maximum number of concurrent stations on the provisioning AP.

    config APP_WIFI_MAX_RETRY
        int "STA max retries before AP fallback"
        range 1 20
        default 5
        help
            After this many consecutive STA connection failures the device
            falls back to pure AP mode and waits for the user to provision
            new credentials.

    config APP_WIFI_FORCE_PROVISION_GPIO
        int "GPIO used for BOOT long-press Wi-Fi provisioning"
        range -1 49
        default -1
        help
            GPIO sampled as an active-low BOOT/config button. Set to -1 to
            disable. Board profiles such as ESP32-S3 SuperMini can set this
            to GPIO0.

    config APP_WIFI_FORCE_PROVISION_HOLD_MS
        int "BOOT hold time for Wi-Fi provisioning"
        range 500 30000
        default 5000
        help
            Holding the configured BOOT GPIO low for this many milliseconds
            requests a one-shot provisioning boot. Saved Wi-Fi credentials
            are kept; the next boot simply skips STA and opens the AP portal.

endmenu

menu "Status LED"

    config APP_STATUS_LED_WS2812_GPIO
        int "WS2812 status LED GPIO"
        range -1 49
        default -1
        help
            GPIO for a single WS2812 status LED. Set to -1 to disable. The
            firmware keeps the LED off during normal operation and blinks it
            slowly only while the provisioning AP is open.

    config APP_STATUS_LED_AP_BLINK_MS
        int "Provisioning AP LED blink interval"
        range 100 5000
        default 800
        help
            Blink interval for the status LED when the provisioning AP is
            active and STA Wi-Fi is not connected.

endmenu

menu "Default Web Admin Security"

    config APP_ADMIN_USERNAME
        string "Default Web Admin username"
        default "admin"
        help
            Build-time fallback username for STA Web Admin HTTP Basic Auth.
            NVS config takes precedence.

    config APP_ADMIN_PASSWORD
        string "Default Web Admin password"
        default ""
        help
            Optional build-time fallback password for STA Web Admin HTTP
            Basic Auth. If unset and no NVS password exists, the firmware
            generates a password from the provisioning AP suffix and prints it
            to the serial log.

endmenu

menu "Default Voice Settings"

    config APP_VOICE_SERVER_URL
        string "Default voice WebSocket server URL"
        default ""
        help
            Optional default LAN voice server URL used by documentation and
            Web Admin config. The SuperMini Lua voice-stream script also
            accepts a per-run uri argument.

    config APP_VOICE_PTT_GPIO
        int "GPIO used for push-to-talk voice streaming"
        range -1 49
        default -1
        help
            GPIO sampled as a push-to-talk input. Set to -1 to disable. The
            ESP32-S3 SuperMini profile maps this to BOOT/GPIO0.

    config APP_VOICE_PTT_ACTIVE_LEVEL
        int "Push-to-talk active level"
        range 0 1
        default 0
        help
            Logic level treated as pressed for the push-to-talk GPIO.

    config APP_VOICE_PTT_MAX_RECORD_MS
        int "Push-to-talk maximum record time"
        range 1000 120000
        default 60000
        help
            Safety cap for one push-to-talk utterance. Releasing the button
            ends recording earlier.

    config APP_VOICE_PTT_MIN_RECORD_MS
        int "Push-to-talk minimum record time"
        range 0 5000
        default 300
        help
            Minimum capture time before a button release is allowed to stop
            the current utterance. This avoids empty streams from short taps.

    config APP_VOICE_PTT_PLAYBACK_TIMEOUT_MS
        int "Push-to-talk playback wait timeout"
        range 0 60000
        default 20000
        help
            Maximum time to keep the voice WebSocket open waiting for server
            reply audio after recording stops.

endmenu

menu "Default Search Settings"

    config APP_SEARCH_HTTP_ALLOWLIST
        string "Default HTTP Request allowlist"
        default "*"
        help
            Default value used to populate app setting `search_http_allowlist`.
            Use `*` to allow all hosts, or a comma-separated list of domains/IPs.

            e.g. "api.example.com,*.example.org,203.0.113.10"

endmenu

endmenu
```
